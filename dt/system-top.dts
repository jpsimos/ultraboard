/*
 * CAUTION: This file is automatically generated by Xilinx.
 * Version: XSCT 2024.2
 * Today is: Sun Aug  9 12:07:29 2026
 */


/dts-v1/;
#include "zynqmp.dtsi"
#include "zynqmp-clk-ccf.dtsi"
#include "pl.dtsi"
#include "pcw.dtsi"
/ {
	/delete-node/ aliases ;
	chosen {
		bootargs = "console=ttyPS0,115200 root=/dev/mmcblk1p2 ro rootwait earlycon";
		stdout-path = "serial0:115200n8";
	};
	aliases {
		ethernet0 = &gem2;
		ethernet1 = &gem3;
		i2c0 = &i2c1;
		serial0 = &uart0;
		serial1 = &dcc;
		serial2 = &uart1;
		serial3 = &rs485_axi_uart16550_0;
		serial4 = &rs485_axi_uart16550_1;
		spi0 = &qspi;
	};
	memory@0 {
		device_type = "memory";
		reg = <0x0 0x0 0x0 0x7ff00000>, <0x00000008 0x00000000 0x0 0x80000000>;
	};
};
