/*
 * CAUTION: This file is automatically generated by Xilinx.
 * Version: XSCT 2024.2
 * Today is: Sun Aug  9 12:07:29 2026
 */


&gem2 {
	local-mac-address = [00 0a 35 00 00 00];
};
&gem3 {
	local-mac-address = [00 0a 35 00 00 01];
};
